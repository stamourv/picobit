## vm/Kconfig
```kconfig
mainmenu "Picobit Virtual Machine Configuration"

choice
	prompt "Target architecture"
	help
	  Select a platform to run Picobit VM on.
	  

	config	ARCH_HOST
		bool "Host executable"
		select ARCH_32BIT
		select ERROR_HANDLING
		select DEBUG_STRINGS
		help
		  Build Picobit as a host (Linux) executable for easy
		  debugging.
		  

	config	ARCH_ARM
		bool "ARM microcontrollers"
		select ARCH_32BIT
endchoice

config ERROR_HANDLING
	bool

config DEBUG_STRINGS
	bool

config ARCH_8BIT
	bool

config ARCH_32BIT
	bool

config ARCH
	string
	default "host" if ARCH_HOST
	default "arm" if ARCH_ARM

if ARCH_HOST
source "arch/host/Kconfig"
endif

if ARCH_ARM
source "arch/arm/Kconfig"
endif

source "core/Kconfig"
```

## vm/arch/arm/Kconfig
```kconfig
config CROSS_COMPILER
	string "Cross compiler prefix"
	default "arm-none-eabi-"

choice
	prompt "Processor core type"

	config ARM_CORTEX_M3
	bool "Cortex-M3"
endchoice

if ARM_CORTEX_M3
source "arch/arm/cortex-m3/Kconfig"
endif
```

## vm/arch/arm/cortex-m3/Kconfig
```kconfig
choice
	prompt "Processor model"

	config ARM_CPU_STM32F100RB
	bool "ST STM32F100RB"
endchoice

choice
	prompt "Board name"

	config ARM_BOARD_STM32_VLDISCOVERY
	bool "STM32 VLDISCOVERY"
endchoice
```

## vm/core/Kconfig
```kconfig
choice
	prompt "Bignum precision"
	help
	  Code may be shrinked by omitting arbitrary
	  precision bignums.

	config BIGNUM_FIXED
		bool "Fixed 24-bit"
		help
		  A very small bignum implementation which has a fixed
		  precision. Currently it is only useful on 8-bit targets,
		  and bignums are 24 bit long.

	config BIGNUM_LONG
		bool "Arbitrary"
		help
		  Arbitrary precision bignums are represented by lists of
		  16-bit values, and computations are performed by helper
		  functions.
endchoice

config VM_DEBUG
	bool "Debug virtual machine"
	help
	  Enable virtual machine trace messages. Each instruction
	  will be printed before executing.

config GC_STATISTICS
	bool "Collect statistics in garbage collector"
	help
	  Enable measuring various memory allocation statistics.
	  Currently it is only a maximal number of live objects.

config GC_STATISTICS_PRIMITIVE
	depends on GC_STATISTICS
	bool "Export statistics to user program"
	help
	  Add a #%gc-max-live primitive.

config GC_DEBUG
	bool "Debug garbage collector"
	help
	  Enable garbage collector trace messages.

config GC_AGGRESSIVE
	bool "Aggressive GC"
	depends on GC_DEBUG
	help
	  Collect garbage before each allocation and not only
	  when VM has no free memory.
```
